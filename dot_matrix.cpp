#include <LedControl.h>

LedControl lc=LedControl(12,11,10,1);
bool start=false,stop=false;
uint8_t x=0,y=0;

const byte a[14][8]={
  {0x00,0x00,0x00,0x00,0x00,0x00,0x00,0x00}, // 0
  {0x7E,0x7E,0x60,0x7C,0x7C,0x60,0x7E,0x7E}, // E
  {0x60,0x60,0x60,0x60,0x60,0x60,0x7E,0x7E}, // L
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  {0x3C,0x42,0xA5,0x81,0xA5,0x99,0x42,0x3C} // SMILEY
};

void setup() {
  pinMode(9,INPUT_PULLUP);
  pinMode(8,INPUT_PULLUP);

  lc.shutdown(0,false);
  lc.setIntensity(0,3);
  lc.clearDisplay(0);
}
void loop() {
  x=0;
  y=0;

  while(y<14){

    if(digitalRead(9)==0){
      if(start==false){ start=true; stop=false;}
      else{ start=false; stop=true;}
    }
    if(digitalRead(8)==0) stop=true;

    if(start==true && stop==false){
      x=0;
      while(x<8){
        lc.setRow(0,x,a[y][x]);
        x++;
      }

      if(y!=13)
        delay(500);
      else
        delay(1000);
      y++;
    }

    if(stop==true){
      y=0;
      lc.clearDisplay(0);
    }
  }
}